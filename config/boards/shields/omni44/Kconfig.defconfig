## config/boards/shields/omni44/Kconfig.defconfig
```kconfig
# Copyright (c) 2026 The ZMK Contributors
# SPDX-License-Identifier: MIT

if SHIELD_OMNI44_LEFT || SHIELD_OMNI44_RIGHT

config ZMK_SPLIT
    default y

endif

if SHIELD_OMNI44_LEFT

config ZMK_SPLIT_ROLE_CENTRAL
    default y

endif
```

## config/boards/shields/omni44/Kconfig.shield
```kconfig
# Copyright (c) 2026 The ZMK Contributors
# SPDX-License-Identifier: MIT

config SHIELD_OMNI44_LEFT
    def_bool $(shields_list_contains,omni44_left)

config SHIELD_OMNI44_RIGHT
    def_bool $(shields_list_contains,omni44_right)
```
